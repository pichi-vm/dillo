/dts-v1/;

/ {
	#address-cells = <1>;
	#size-cells = <1>;

	intc: interrupt-controller@10000000 {
		compatible = "arm,gic-v3";
		#interrupt-cells = <3>;
		interrupt-controller;
		reg = <0x10000000 0x10000>;
		phandle = <0x01>;
	};

	timer {
		compatible = "arm,armv8-timer";
		interrupt-parent = <&intc>;
		interrupts = <1 13 4>;
	};
};
